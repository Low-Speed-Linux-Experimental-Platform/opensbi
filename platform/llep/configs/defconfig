## platform/llep/configs/defconfig
```kconfig
# SBI Extension Support
CONFIG_SBI_ECALL_TIME=y
CONFIG_SBI_ECALL_DBCN=y
CONFIG_SBI_ECALL_LEGACY=y
CONFIG_SBI_ECALL_VENDOR=y

# Utils and Drivers Support
CONFIG_FDT=y
CONFIG_FDT_DOMAIN=y
CONFIG_FDT_PMU=y

# Serial Device Support
CONFIG_FDT_SERIAL=y
CONFIG_FDT_SERIAL_UART8250=y
CONFIG_SERIAL_UART8250=y

# Regmap Support
CONFIG_FDT_REGMAP=y
CONFIG_FDT_REGMAP_SYSCON=y
CONFIG_REGMAP=y

CONFIG_LIBFDT=y

# Interrupt Controller Support
CONFIG_IRQCHIP_PLIC=y
```
